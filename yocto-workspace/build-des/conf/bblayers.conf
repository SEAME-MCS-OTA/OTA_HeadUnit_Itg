## yocto-workspace/build-des/conf/bblayers.conf
```bitbake
# POKY_BBLAYERS_CONF_VERSION is increased each time build/conf/bblayers.conf
# changes incompatibly
POKY_BBLAYERS_CONF_VERSION = "2"

BBPATH = "${TOPDIR}"
BBFILES ?= ""

BBLAYERS ?= " \
  /home/jeongmin/OTA_HeadUnit_Itg/yocto-workspace/poky/meta \
  /home/jeongmin/OTA_HeadUnit_Itg/yocto-workspace/poky/meta-poky \
  /home/jeongmin/OTA_HeadUnit_Itg/yocto-workspace/poky/meta-yocto-bsp \
  "
BBLAYERS += " ${TOPDIR}/../meta-rauc "
BBLAYERS += " ${TOPDIR}/../meta-openembedded/meta-oe "
BBLAYERS += " ${TOPDIR}/../meta-openembedded/meta-python "
BBLAYERS += " ${TOPDIR}/../meta-openembedded/meta-networking "
BBLAYERS += " ${TOPDIR}/../meta-qt6 "
BBLAYERS += " ${TOPDIR}/../meta-raspberrypi "
BBLAYERS += " ${TOPDIR}/../meta-custom/meta-env "
BBLAYERS += " ${TOPDIR}/../meta-custom/meta-app "
BBLAYERS += " ${TOPDIR}/../meta-custom/meta-piracer "
```

## yocto-workspace/meta-custom/meta-env/conf/distro/des.conf
```bitbake
DISTRO = "des"
DISTRO_NAME = "DES Head-Unit"
DISTRO_VERSION = "1.0"
VIRTUAL-RUNTIME_init_manager = "systemd"
DISTRO_FEATURES:append = " systemd wayland opengl pulseaudio bluetooth pam usrmerge rauc"
QT_QPA_PLATFORM ?= "wayland"
PACKAGE_CLASSES ?= "package_rpm"
SYSTEMD_DEFAULT_TARGET = "graphical.target"
PACKAGECONFIG:append:pn-systemd = " timesyncd"
ROOT_HOME = "/root"
LICENSE_FLAGS_ACCEPTED:append = " synaptics-killswitch"
INHERIT += "report-error"

# OTA A/B boot switching uses Raspberry Pi firmware direct-boot + /boot/cmdline.txt
# (yg repository strategy). Keep U-Boot disabled to avoid slot-source conflicts
# with RAUC custom backend scripts that update cmdline.txt root=.
RPI_USE_U_BOOT:raspberrypi4-64 = "0"
```

## yocto-workspace/meta-custom/meta-env/wic/des-ab-sdimage.wks
```
# short-description: A/B rootfs SD card image for DES Head-Unit OTA
# long-description:
#   Creates a partitioned SD card image with dual rootfs (A/B) for
#   over-the-air image updates on Raspberry Pi 4.
#
#   Layout:
#     p1  /boot     vfat   128 MB   kernel, dtb, overlays, cmdline/config
#     p2  rootfs-a  ext4   2.5 GB   active slot A (initial)
#     p3  rootfs-b  ext4   2.5 GB   inactive slot B (OTA target)
#     p4  /data     ext4   1 GB+    persistent: downloads, state, logs, user data

part /boot --source bootimg-partition --ondisk mmcblk0 --fstype=vfat --label boot --active --align 4096 --size 128
part /     --source rootfs            --ondisk mmcblk0 --fstype=ext4 --label rootfs-a --align 4096 --fixed-size 2560 --no-fstab-update
part       --ondisk mmcblk0           --fstype=ext4 --label rootfs-b --align 4096 --fixed-size 2560
part       --ondisk mmcblk0           --fstype=ext4 --label data     --align 4096 --size 1024
```
